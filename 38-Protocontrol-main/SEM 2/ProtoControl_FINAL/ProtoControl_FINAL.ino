#include <Arduino.h>
#include <Adafruit_GFX.h>
#include <SPI.h>
#include <Wire.h>
#include <Adafruit_ILI9341.h>
#include <Adafruit_FT6206.h>
#include <WiFi.h>
#include <ArduinoHttpClient.h>
#include "I2CKeyPad.h"
#include "elements.h"
#include "PCF8574.h"
#include <seesaw_neopixel.h>
#include "SPIFFS.h"
#include <Adafruit_ADS1X15.h>
//include
#define ssid "ncsu" //ncsu
#define pass ""

#define TFT_CS 10
#define TFT_DC 9

#define SEESAW_ADDR          0x38
#define SS_SWITCH            24
#define SS                    6
#define LED                   13

#define cardSelect            4




// 'ProtoControl', 320x240px
const unsigned char epd_bitmap_ProtoControl [] PROGMEM = {
	0x00, 0x00, 0x00, 0x00, 0x00, 0x00, 0x00, 0x00, 0x00, 0x00, 0x00, 0x00, 0x00, 0x00, 0x00, 0x00, 
	0x00, 0x00, 0x00, 0x00, 0x00, 0x00, 0x00, 0x00, 0x00, 0x00, 0x00, 0x00, 0x00, 0x00, 0x00, 0x00, 
	0x00, 0x00, 0x00, 0x00, 0x00, 0x00, 0x00, 0x00, 0x00, 0x00, 0x00, 0x00, 0x00, 0x00, 0x00, 0x00, 
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	0x00, 0x00, 0x00, 0x00, 0x00, 0x00, 0x00, 0x00, 0x00, 0x00, 0x00, 0x00, 0x00, 0x00, 0x00, 0x00
};





PCF8574 pcf8574(0x3A);
int encoder = false;
int profileSelect = 1;
bool switchPressed = false;
Adafruit_FT6206 ts = Adafruit_FT6206();
Adafruit_ILI9341 tft = Adafruit_ILI9341(TFT_CS, TFT_DC);

WiFiClient client;
HttpClient httpClient = HttpClient(client, "protocontrol.pythonanywhere.com", 80);


Adafruit_ADS1115 ads;  /* Use this for the 16-bit version */

//const int SW_pin = 8; // digital pin connected to switch output
const int Y_pin = 0; // analog pin connected to Y output (20 to 26790)
const int X_pin = 1; // analog pin connected to X output (20 to 26790)

bool joystick = false;
const int pButton = 5;
const int uButton = 6;
bool updating = false;
const int MAX = 255;
const int MIN = 0;
int n;
int running_count_new;
int running_count_old;
int raw_val_old = 0;
int raw_val_new;

int16_t adc0, adc1;
int16_t adc0_last = 0;
int16_t adc1_last = 0;
float volts0, volts1;


int pushIndex = 0;
PushButton* buttons[12];
int incIndex = 0;
increment* increments[12];
int togIndex = 0;
Toggle* toggles[12];
int conIndex = 0;
Slider* sliders[12];
int sldIndex = 0;

String communication;

String commands[12][10];
Console con;
Slider slide = Slider(5,5,false,0,255);
bool key = false;

//i2c components
//keypad
const uint8_t KEYPAD_ADDRESS = 0x39;

I2CKeyPad keyPad(KEYPAD_ADDRESS);
int keypads = false;
uint32_t start, stop;
uint32_t lastKeyPressed = 0;

const char keys[20] = "147*N2580N369#XXX";

void setup(void) {
  
  Serial.begin(115200);
  Serial1.begin(115200);
  SPI.begin();
  pinMode(LED, OUTPUT);
  tft.begin();
  ts.begin(40);
  tft.setRotation(1);
  tft.fillScreen(ILI9341_BLACK);
  tft.drawBitmap(0,0,epd_bitmap_ProtoControl,320,240,ILI9341_WHITE);
  ads.setGain(GAIN_ONE);        // 1x gain   +/- 4.096V  1 bit = 2mV      0.125mV


  pinMode(uButton, INPUT_PULLUP);
  pinMode(pButton, INPUT_PULLUP);
  WiFi.begin(ssid, pass);
  while (WiFi.status() != WL_CONNECTED)
    delay(500);

  Serial.println("Connected to WiFi");
  digitalWrite(LED,HIGH);
  printWifiStatus();

  //sendGetRequest();
  updateProfile(tft);



  //con.drawConsole(tft);
  //slide.drawSlider(tft);
  //con.displayMessage("Light Level: 21",tft);
 // Slider s1 = Slider(110,5,true,0,100);
 // s1.drawSlider(tft);
}

void loop() {
  int switchState = digitalRead(pButton);
  if (!switchState && !switchPressed) {
    switchPressed = true;
    profileSelect++;
    if(profileSelect > 5){
      profileSelect = 1;
    }
    updateProfile(tft);
  }

  // Check if the switch is released
  if (switchState && switchPressed) {
    switchPressed = false; // Update the switch state to not pressed
    }

  if(!digitalRead(uButton) && !updating){
    updating = true;
    Serial.println("PRESSED");
    updateProfile(tft);
  }
  if (ts.touched()) {
    TS_Point p = ts.getPoint();
    p.x = map(p.x, 0, 240, 240, 0);
    p.y = map(p.y, 0, 320, 320, 0);
    int y = tft.height() - p.x;
    int x = p.y;
    int temp = p.y;
    p.y = p.x;
    p.x = temp;


    for(int i = 0;i < pushIndex;i++){
      buttons[i]->handleTouch(p.x,p.y,tft);
    }
    for(int i = 0;i < incIndex;i++){
      increments[i]->handleTouch(p.x,p.y,tft);
    }
    for(int i = 0;i < togIndex;i++){
      toggles[i]->handleTouch(p.x,p.y,tft);
    }
    for(int i = 0;i < sldIndex;i++){
      sliders[i]->handleTouch(p.x,p.y,tft);
    }


  }
  if(keypads){
      uint8_t index = keyPad.getKey();
      if (index < 16 && key == false){
        //key = true;
        
        if(lastKeyPressed != index){
          Serial1.println("M"+(String)keys[index]);
          Serial.println("M"+(String)keys[index]);
          //Serial.println(index);
          delay(10);
        }
        //Serial.print("\n");

        
      }
      lastKeyPressed = index;
      
  }
  if(encoder){
    raw_val_new = pcf8574.readEncoderValue(P1, P2);
    if (raw_val_old != raw_val_new) {
      if (raw_val_new == 1) {
        running_count_new++;
        //Serial.println(running_count_new);
      }
      else if (raw_val_new == -1) {
        running_count_new--;
        //Serial.println(running_count_new);
      }
      Serial1.println("N"+(String)running_count_new);
      Serial.println("N"+(String)running_count_new);
    }
    raw_val_old = raw_val_new;
  }
  if(joystick){
    adc0 = ads.readADC_SingleEnded(X_pin);
    adc1 = ads.readADC_SingleEnded(Y_pin);

    volts0 = ads.computeVolts(adc0);
    volts1 = ads.computeVolts(adc1);

    if ((adc0 >= 14000) || (adc0 <= 12000) || (adc1 >= 14000) || (adc1 <= 12000)) {
      //O and P for x and y
      //map(value, fromLow, fromHigh, toLow, toHigh)
      adc0 = map(adc0,18,26271,0,190);
      Serial1.println("O"+(String)adc0);
      Serial.println("O"+(String)adc0);

      adc1 = map(adc1,18,26271,0,190);
      Serial1.println("P"+(String)adc1);
      Serial.println("P"+(String)adc1);

      // Serial.print("X-axis: ");
      // Serial.print(adc0);
      // Serial.print(" | ");
      // Serial.print("Y-axis: ");
      // Serial.print(adc1);
      // Serial.println(" | ");
    }
  }
  if(Serial1.available()){
    communication = Serial1.readStringUntil('\n');
    Serial.println(communication);
    if(communication[0] == '+'){
      communication.remove(0,1);
      if(conIndex > 0){
        con.displayMessage(communication.c_str(),tft);
      }
      //con.displayMessage(communication.c_str(),tft);
    }

  }




}

void printWifiStatus() {
  Serial.print("SSID: ");
  Serial.println(WiFi.SSID());
  IPAddress ip = WiFi.localIP();
  Serial.print("IP Address: ");
  Serial.println(ip);
  long rssi = WiFi.RSSI();
  Serial.print("signal strength (RSSI):");
  Serial.print(rssi);
  Serial.println(" dBm");
  Serial.println(WiFi.macAddress());
}

void updateProfile(Adafruit_ILI9341 &tft) {
  Serial.println("PROFILE UPDATING");
  Serial.println(profileSelect);
  Wire.begin();
  Wire.setClock(400000);
  tft.fillScreen(ILI9341_LIGHTGREY);
  keypads = true;
  if (keyPad.begin() == false)
  {
    Serial.println("\nERROR: cannot communicate to keypad.\nPlease reboot.\n");
    Serial.println(KEYPAD_ADDRESS);
    //while(1);
    keypads = false;
  }


  keyPad.setKeyPadMode(I2C_KEYPAD_5x3);

  pcf8574.pinMode(P2, INPUT);
  pcf8574.pinMode(P1, INPUT);
  Serial.println("SetupStarted");

  if (pcf8574.begin()) {
    Serial.println("Rotary Encoder Connected");
    encoder = true;
  }else{
    Serial.println("Rotary Encoder Not Connected");

  }

  if (!ads.begin()) {
    Serial.println("Failed to initialize ADS.");
  }else{
    joystick = true;
  }

//delete memory
  for(int i = 0;i < pushIndex;i++){
    delete buttons[i];
    buttons[i] = NULL;
  }
  for(int i = 0;i < incIndex;i++){
    delete increments[i];
    increments[i] = NULL;
  }
  for(int i = 0;i < togIndex;i++){
    delete increments[i];
    increments[i] = NULL;
  }
  for(int i = 0;i< sldIndex;i++){

    delete sliders[i];
    sliders[i] = NULL;
  }
  conIndex = 0;
  pushIndex = 0;
  incIndex = 0;
  togIndex = 0;
  sldIndex = 0;


  Serial.println("/latest-entry?Device=beta&Profile="+(String)profileSelect);

  httpClient.get("/latest-entry?Device=beta&Profile="+(String)profileSelect);
  //httpClient.get("/latest-entry?Device=beta&Profile=1");

  int statusCode = httpClient.responseStatusCode();
  String input = httpClient.responseBody();

  Serial.println("Response status code:");
  Serial.println(statusCode);
  Serial.println("Response body:");
  Serial.println(input);
  //Serial.println(input[11]);
  input = input.substring(11,input.length());
  int row = 0;
  int col = 0;
  int startIndex = 0;


  for (int i = 0; i < input.length(); i++) {
    char currentChar = input.charAt(i);
    if (currentChar == ',' || currentChar == '|') {
      if (i > startIndex) {
        commands[row][col++] = input.substring(startIndex, i);
      }
      startIndex = i + 1;
    }
    if (currentChar == '|') {
      row++;
      col = 0;
      startIndex = i + 1;
    }
  }




  for (int i = 0; i < row; i++) {

    if (commands[i][0] == "PushButton") {
        buttons[pushIndex] = new PushButton(commands[i][1].toInt(), commands[i][2].toInt(), strtoul(commands[i][3].c_str(), NULL, 16), strtoul(commands[i][4].c_str(), NULL, 16), commands[i][5].c_str());
        pushIndex++;
    }else if(commands[i][0] == "Increment"){
        increments[incIndex] = new increment(commands[i][1].toInt(), commands[i][2].toInt(),strtoul(commands[i][3].c_str(), NULL, 16));
        incIndex++;
    }else if(commands[i][0] == "ToggleButton"){
        toggles[togIndex] = new Toggle(commands[i][1].toInt(), commands[i][2].toInt(),strtoul(commands[i][3].c_str(), NULL, 16));
        togIndex++;
    }else if(commands[i][0] == "Terminal"){
        con = Console(commands[i][1].toInt(), commands[i][2].toInt());
        conIndex++;
    }else if(commands[i][0] == "Slider"){
        sliders[sldIndex] = new Slider(commands[i][1].toInt(), commands[i][2].toInt(),commands[i][3].toInt(),commands[i][4].toInt(),commands[i][5].toInt());
        sldIndex++;
    }

  }
  for(int i = 0;i < pushIndex;i++){
    buttons[i]->drawButton(tft);
  }
  for(int i = 0;i < incIndex;i++){
    increments[i]->drawIncrement(tft);
  }
  for(int i = 0;i < togIndex;i++){
    toggles[i]->drawToggle(tft);
  }
  for(int i = 0;i< sldIndex;i++){
    sliders[i]->drawSlider(tft);
  }for(int i = 0;i<conIndex;i++){
    con.drawConsole(tft);

  }
  updating = false;
}


String updateProfileMemory(Adafruit_ILI9341 &tft,String input) {
  Serial.println("PROFILE UPDATING");
  Serial.println(profileSelect);
  tft.fillScreen(ILI9341_LIGHTGREY);
//delete memory
  for(int i = 0;i < pushIndex;i++){
    delete buttons[i];
    buttons[i] = NULL;
  }
  for(int i = 0;i < incIndex;i++){
    delete increments[i];
    increments[i] = NULL;
  }
  for(int i = 0;i < togIndex;i++){
    delete increments[i];
    increments[i] = NULL;
  }
  for(int i = 0;i< sldIndex;i++){

    delete sliders[i];
    sliders[i] = NULL;
  }
  conIndex = 0;
  pushIndex = 0;
  incIndex = 0;
  togIndex = 0;
  sldIndex = 0;

  Serial.println(input);
  //Serial.println(input[11]);

  int row = 0;
  int col = 0;
  int startIndex = 0;


  for (int i = 0; i < input.length(); i++) {
    char currentChar = input.charAt(i);
    if (currentChar == ',' || currentChar == '|') {
      if (i > startIndex) {
        commands[row][col++] = input.substring(startIndex, i);
      }
      startIndex = i + 1;
    }
    if (currentChar == '|') {
      row++;
      col = 0;
      startIndex = i + 1;
    }
  }




  for (int i = 0; i < row; i++) {

    if (commands[i][0] == "PushButton") {
        buttons[pushIndex] = new PushButton(commands[i][1].toInt(), commands[i][2].toInt(), strtoul(commands[i][3].c_str(), NULL, 16), strtoul(commands[i][4].c_str(), NULL, 16), commands[i][5].c_str());
        pushIndex++;
    }else if(commands[i][0] == "Increment"){
        increments[incIndex] = new increment(commands[i][1].toInt(), commands[i][2].toInt(),strtoul(commands[i][3].c_str(), NULL, 16));
        incIndex++;
    }else if(commands[i][0] == "ToggleButton"){
        toggles[togIndex] = new Toggle(commands[i][1].toInt(), commands[i][2].toInt(),strtoul(commands[i][3].c_str(), NULL, 16));
        togIndex++;
    }else if(commands[i][0] == "Terminal"){
        con = Console(commands[i][1].toInt(), commands[i][2].toInt());
        conIndex++;
    }else if(commands[i][0] == "Slider"){
        sliders[sldIndex] = new Slider(commands[i][1].toInt(), commands[i][2].toInt(),commands[i][3].toInt(),commands[i][4].toInt(),commands[i][5].toInt());
        sldIndex++;
    }

  }
  for(int i = 0;i < pushIndex;i++){
    buttons[i]->drawButton(tft);
  }
  for(int i = 0;i < incIndex;i++){
    increments[i]->drawIncrement(tft);
  }
  for(int i = 0;i < togIndex;i++){
    toggles[i]->drawToggle(tft);
  }
  for(int i = 0;i< sldIndex;i++){
    sliders[i]->drawSlider(tft);
  }for(int i = 0;i<conIndex;i++){
    con.drawConsole(tft);

  }
  
}


void sendGetRequest() {
  httpClient.get("/random-coords");
  int statusCode = httpClient.responseStatusCode();
  String response = httpClient.responseBody();

  Serial.println("Response status code:");
  Serial.println(statusCode);
  Serial.println("Response body:");
  Serial.println(response);
}



// void drawComponents(Adafruit_ILI9341 &tft){
//   File logfile;
//   logfile = SD.open(filename);
//         if(!logfile) {
//           Serial.print("Couldn't open ");
//           Serial.println(filename);
//         } else {
//           Serial.print("reading from ");
//           Serial.println(filename);
//         }
//         int inc = 0;
//         int line = 0;
//         while (logfile.available()) {

//             String parse = logfile.readStringUntil(',');
//             //Serial.write(parse);
//             Serial.println(parse);
//             inits[line][inc] = parse;
//             inc++;
//             if(parse == "|"){
//               line++;
//               inc = 0;
//               Serial.print(parse.c_str());
//               Serial.print("^");
//             }


//           }

//         Serial.println(line);
//         Serial.println(inits[1][0]);
//         Serial.println(inits[1][1]);
//         Serial.println(inits[1][2]);
//         Serial.println(inits[1][3]);
//         // Serial.print("<-");
//         for(int i = 0;i<=line;i++){
//               String cmp = "PushButton";
//               if(inits[i][0] == cmp){
//                 b1 = PushButton(inits[i][1].toInt(),inits[i][2].toInt(),strtoul(inits[i][3].c_str(),NULL,16),strtoul(inits[i][4].c_str(),NULL,16),inits[i][5].c_str());
//                 b1.drawButton(tft);
//               }
//               cmp = "Toggle";
//               if(inits[i][0] == cmp){
//                   t1 = Toggle(inits[i][1].toInt(),inits[i][2].toInt(),strtoul(inits[i][3].c_str(),NULL,16));
//                   t1.drawToggle(tft);
//               }
//               cmp = "increment";
//               if(inits[i][0] == cmp){
//                   i1 = increment(inits[i][1].toInt(),inits[i][2].toInt(),strtoul(inits[i][3].c_str(),NULL,16));
//                   i1.drawIncrement(tft);
//               }
//         }
// }